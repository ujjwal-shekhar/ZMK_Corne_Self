## config/west.yml
```yaml
manifest:
  remotes:
    - name: zmkfirmware
      url-base: https://github.com/zmkfirmware
    # - name: m165437 #new entry
    #   url-base: https://github.com/M165437 #new entry
    - name: infely                             # new entry
      url-base: https://github.com/infely      # new entry
  projects:
    - name: zmk
      remote: zmkfirmware
      revision: v0.3
      import: app/west.yml
    # - name: nice-view-gem #new entry
    #   remote: m165437 #new entry
    #   revision: main #new entry
    - name: nice-view-battery                  # new entry
      remote: infely                           # new entry
      revision: main                           # new entry
  self:
    path: config
```
